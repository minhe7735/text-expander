## Kconfig
```kconfig
mainmenu "ZMK Text Expander"

menu "ZMK Text Expander"

config ZMK_TEXT_EXPANDER
    bool "Enable Text Expander Behavior"
    default n
    help
      Enable the text expander module to define and use text expansions.
if ZMK_TEXT_EXPANDER

config ZMK_TEXT_EXPANDER_TYPING_DELAY
    int "Typing delay between characters (ms)"
    default 10
    help
      Sets the delay in milliseconds between each typed character during expansion.

config ZMK_TEXT_EXPANDER_EVENT_QUEUE_SIZE
    int "Size of the key event queue"
    default 16
    range 4 64
    help
      Sets the number of key press/release events that can be buffered.
      Increase this if you see 'Failed to queue key event' warnings.

config ZMK_TEXT_EXPANDER_AGGRESSIVE_RESET_MODE
    bool "Aggressive Reset Mode"
    default n
    help
      If enabled, the current short code will be reset immediately if it does
      not match a valid prefix of any stored expansion.

config ZMK_TEXT_EXPANDER_RESTART_AFTER_RESET_WITH_TRIGGER_CHAR
    bool "Restart short code with trigger character after a reset"
    depends on ZMK_TEXT_EXPANDER_AGGRESSIVE_RESET_MODE
    default n
    help
      If the short code is reset (e.g., in aggressive mode), the character
      that caused the reset will be used to start a new short code.

choice ZMK_TEXT_EXPANDER_HOST_LAYOUT
    prompt "Host Keyboard Layout"
    default ZMK_TEXT_EXPANDER_LAYOUT_US
    help
      Select the keyboard layout configured on the host computer (OS).
      The text expander will adjust its output keycodes to match this layout.

config ZMK_TEXT_EXPANDER_LAYOUT_US
    bool "US QWERTY (Standard)"

config ZMK_TEXT_EXPANDER_LAYOUT_FRENCH
    bool "French AZERTY"

config ZMK_TEXT_EXPANDER_LAYOUT_GERMAN
    bool "German QWERTZ"

endchoice

config ZMK_TEXT_EXPANDER_DEFAULT_OS_LINUX
    bool "Default to Linux for Unicode input"
    help
      Sets the default OS for Unicode text expansion to Linux.
      This has the highest priority.

config ZMK_TEXT_EXPANDER_DEFAULT_OS_MACOS
    bool "Default to macOS for Unicode input"
    depends on !ZMK_TEXT_EXPANDER_DEFAULT_OS_LINUX
    help
      Sets the default OS for Unicode text expansion to macOS.
      This option is ignored if the Linux default is selected.

config ZMK_TEXT_EXPANDER_DEFAULT_OS_WINDOWS
    bool "Default to Windows for Unicode input"
    depends on !ZMK_TEXT_EXPANDER_DEFAULT_OS_LINUX && !ZMK_TEXT_EXPANDER_DEFAULT_OS_MACOS
    default y
    help
      Sets the default OS for Unicode text expansion to Windows.
      This is the default and is ignored if either the Linux or macOS default is selected.

endif

endmenu
```
